## conf/layer.conf
```bitbake
# We have a conf and classes directory, add to BBPATH
BBPATH .= ":${LAYERDIR}"

# We have recipes-* directories, add to BBFILES
BBFILES += "${LAYERDIR}/recipes-*/*/*.bb \
            ${LAYERDIR}/recipes-*/*/*.bbappend"

BBFILE_COLLECTIONS += "lts-kernel"
BBFILE_PATTERN_lts-kernel = "^${LAYERDIR}/"
BBFILE_PRIORITY_lts-kernel = "6"
```
